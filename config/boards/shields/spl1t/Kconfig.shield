## config/boards/shields/spl1t/Kconfig.shield
```kconfig
config SHIELD_SPL1T_LEFT
    def_bool $(shields_list_contains,spl1t_left)

config SHIELD_SPL1T_RIGHT
    def_bool $(shields_list_contains,spl1t_right)

config SHIELD_SPL1T_DONGLE
    def_bool $(shields_list_contains,spl1t_dongle)
```
